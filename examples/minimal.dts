/*
 * Minimal Baseline Device Tree Example
 *
 * Baseline defines hardware resources only (no instances).
 * Usage: kerf init --input=minimal.dts --apply
 */

/multikernel-v1/;

/ {
    compatible = "linux,multikernel-host";

    resources {
        cpus = <2 3 4 5 6 7>;
        memory@0 {
            size = <0x0 0x1C0000000>;  // 7GB
        };
    };
};
