/*
 * Conflict Example Baseline (for testing validation)
 *
 * This baseline is valid. Conflict examples would occur when creating
 * instances with overlapping resources via overlays.
 * Usage: kerf init --input=conflict_example.dts
 */

/multikernel-v1/;

/ {
    compatible = "linux,multikernel-host";

    resources {
        cpus = <2 3 4 5 6 7 8 9 10 11 12 13 14 15>;
        memory-base = <0x100000000>;
        memory-bytes = <0x0 0x300000000>;   // 12GB
    };
};
